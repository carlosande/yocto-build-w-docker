## meta-rpilinux/conf/layer.conf
```bitbake
# We have a conf and classes directory, add to BBPATH
BBPATH =. "${LAYERDIR}:"

# We have recipes-* directories, add to BBFILES
BBFILES += "${LAYERDIR}/recipes-*/*/*.bb \
            ${LAYERDIR}/recipes-*/*/*.bbappend"

BBFILE_COLLECTIONS += "rpilinux"
BBFILE_PATTERN_rpilinux = "^${LAYERDIR}/"
BBFILE_PRIORITY_rpilinux = "6"

LAYERSERIES_COMPAT_rpilinux = "nanbield"

# This should only be incremented on significant changes that will
# cause compatibility issues with other layers
LAYERVERSION_rpilinux = "3"

LAYERDEPENDS_rpilinux = "core"

REQUIRED_POKY_BBLAYERS_CONF_VERSION = "2"
```

## rpi4-64/conf/bblayers.conf
```bitbake
# POKY_BBLAYERS_CONF_VERSION is increased each time build/conf/bblayers.conf
# changes incompatibly
POKY_BBLAYERS_CONF_VERSION = "2"

BBPATH = "${TOPDIR}"
BBFILES ?= ""

BBLAYERS ?= " \
  /home/devel/yocto/sources/poky/meta \
  /home/devel/yocto/sources/poky/meta-poky \
  /home/devel/yocto/sources/poky/meta-yocto-bsp \
  /home/devel/yocto/sources/poky/meta-raspberrypi \ 
  /home/devel/yocto/sources/poky/meta-openembedded/meta-oe \
  /home/devel/yocto/sources/poky/meta-openembedded/meta-python \ 
  /home/devel/yocto/sources/poky/meta-openembedded/meta-networking \ 
  /home/devel/yocto/sources/meta-rpilinux \
  "
```
